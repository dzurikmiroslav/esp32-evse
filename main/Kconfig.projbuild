## main/Kconfig.projbuild
```kconfig
menu "EVSE Configuration"
	
	config BOARD_CONFIG_DEPLOY
		bool "Deploy board config to SPI Nor Flash"
		default y
		help
			Deploy board config to SPI Nor Flash.
			Choose this in production mode or once to copy config.
                
	choice BOARD_CONFIG
		prompt "Board config file"
		default BOARD_CONFIG_ESP32DEVKITC
		help
			Board config file
        
		config BOARD_CONFIG_ESP32MINIMAL
			bool "esp32minimal"
		config BOARD_CONFIG_ESP32S2MINIMAL
			bool "esp32s2minimal"
		config BOARD_CONFIG_ESP32S3MINIMAL
			bool "esp32s3minimal"
		config BOARD_CONFIG_ESP32DEVKITC
			bool "esp32devkitc"
		config BOARD_CONFIG_ESP32S2DA
			bool "esp32s2da"
		config BOARD_CONFIG_CUSTON
			bool "custom"
	endchoice

	config BOARD_CONFIG
		string
		default "esp32minimal" if BOARD_CONFIG_ESP32MINIMAL
		default "esp32s2minimal" if BOARD_CONFIG_ESP32S2MINIMAL
		default "esp32s3minimal" if BOARD_CONFIG_ESP32S3MINIMAL
		default "esp32devkitc" if BOARD_CONFIG_ESP32DEVKITC
		default "esp32s2da" if BOARD_CONFIG_ESP32S2DA
		default "custom" if BOARD_CONFIG_CUSTON

endmenu
```

## sdkconfig.defaults
```kconfig
#
# Partition
#
CONFIG_ESPTOOLPY_FLASHSIZE_4MB=y
CONFIG_PARTITION_TABLE_CUSTOM=y
CONFIG_PARTITION_TABLE_CUSTOM_FILENAME="partitions.csv"
CONFIG_PARTITION_TABLE_FILENAME="partitions.csv"

#
# HTTP Server
#
CONFIG_HTTPD_MAX_REQ_HDR_LEN=1024

#
# LWIP
#
CONFIG_LWIP_LOCAL_HOSTNAME="evse"
CONFIG_LWIP_MAX_SOCKETS=16

#
# ESP System Settings
#
CONFIG_ESP_CONSOLE_NONE=y
CONFIG_ESP_CONSOLE_UART_NUM=-1
CONFIG_ESP_CONSOLE_SECONDARY_NONE=y

#
# Log
#
# CONFIG_LOG_VERSION_1 is not set
CONFIG_LOG_VERSION_2=y
CONFIG_LOG_VERSION=2

#
# Log format
#
CONFIG_LOG_TIMESTAMP_SOURCE_SYSTEM_FULL=y
CONFIG_LOG_TIMESTAMP_SUPPORT=y

#
# Level Settings
#
# CONFIG_LOG_DYNAMIC_LEVEL_CONTROL is not set
CONFIG_LOG_TAG_LEVEL_IMPL_NONE=y

#
# Kernel
#
CONFIG_FREERTOS_THREAD_LOCAL_STORAGE_POINTERS=2
CONFIG_FREERTOS_TIMER_TASK_STACK_DEPTH=4096

#
# LibC
#
# TODO freopen not working in picolib
CONFIG_LIBC_NEWLIB=y
# CONFIG_LIBC_PICOLIBC is not set
```

## sdkconfig.defaults.esp32s2
```kconfig
#
# mbedTLS, some memory optimizations
#
# CONFIG_MBEDTLS_SSL_KEEP_PEER_CERTIFICATE is not set
# CONFIG_MBEDTLS_PKCS7_C is not set
CONFIG_MBEDTLS_DYNAMIC_BUFFER=y
CONFIG_MBEDTLS_DYNAMIC_FREE_CONFIG_DATA=y
CONFIG_MBEDTLS_DYNAMIC_FREE_CA_CERT=y

#
# mDNS, some memory optimizations
#
CONFIG_MDNS_TASK_STACK_SIZE=3072

#
# ESP Timer (High Resolution Timer), some memory optimizations
#
CONFIG_ESP_TIMER_TASK_STACK_SIZE=2048

#
# LWIP, some memory optimizations
# 
# CONFIG_LWIP_IPV6 is not set
```

## test_app/sdkconfig.defaults
```kconfig
#
# Partition
#
CONFIG_LITTLEFS_OBJ_NAME_LEN=64
CONFIG_FATFS_LONG_FILENAME=y
CONFIG_FATFS_LFN_HEAP=y
CONFIG_ESPTOOLPY_FLASHSIZE_4MB=y
CONFIG_PARTITION_TABLE_CUSTOM=y
CONFIG_PARTITION_TABLE_CUSTOM_FILENAME="partitions.csv"
CONFIG_PARTITION_TABLE_FILENAME="partitions.csv"

#
# Trace memory
#
CONFIG_ESP_SYSTEM_PANIC_PRINT_HALT=y

#
# Unity unit testing library
#
CONFIG_UNITY_ENABLE_FIXTURE=y

#
# Power Management
#
CONFIG_PM_ENABLE=y

#
# Kernel
#
CONFIG_FREERTOS_USE_TICKLESS_IDLE=y
CONFIG_ESP_TASK_WDT_EN=n
CONFIG_FREERTOS_THREAD_LOCAL_STORAGE_POINTERS=2
CONFIG_FREERTOS_TIMER_TASK_STACK_DEPTH=4096

#
# LibC
#
# TODO freopen not working in picolib
CONFIG_LIBC_NEWLIB=y
# CONFIG_LIBC_PICOLIBC is not set
```
