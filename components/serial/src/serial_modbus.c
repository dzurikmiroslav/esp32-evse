#include "serial_modbus.h"

#include <esp_log.h>

#include "modbus.h"

#define BUF_SIZE         256
#define EVENT_QUEUE_SIZE 20

#define LOG_LVL_DATA ESP_LOG_VERBOSE

static const char* TAG = "serial_modbus";

static uart_port_t port = -1;

static TaskHandle_t serial_modbus_task = NULL;

static QueueHandle_t uart_queue;

static const uint8_t crc_hi[] = {
    0x00, 0xC1, 0x81, 0x40, 0x01, 0xC0, 0x80, 0x41, 0x01, 0xC0, 0x80, 0x41, 0x00, 0xC1, 0x81, 0x40, 0x01, 0xC0, 0x80, 0x41, 0x00, 0xC1, 0x81, 0x40, 0x00, 0xC1, 0x81, 0x40, 0x01,
    0xC0, 0x80, 0x41, 0x01, 0xC0, 0x80, 0x41, 0x00, 0xC1, 0x81, 0x40, 0x00, 0xC1, 0x81, 0x40, 0x01, 0xC0, 0x80, 0x41, 0x00, 0xC1, 0x81, 0x40, 0x01, 0xC0, 0x80, 0x41, 0x01, 0xC0,
    0x80, 0x41, 0x00, 0xC1, 0x81, 0x40, 0x01, 0xC0, 0x80, 0x41, 0x00, 0xC1, 0x81, 0x40, 0x00, 0xC1, 0x81, 0x40, 0x01, 0xC0, 0x80, 0x41, 0x00, 0xC1, 0x81, 0x40, 0x01, 0xC0, 0x80,
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    0x00, 0xC1, 0x81, 0x40, 0x01, 0xC0, 0x80, 0x41, 0x00, 0xC1, 0x81, 0x40, 0x01, 0xC0, 0x80, 0x41, 0x01, 0xC0, 0x80, 0x41, 0x00, 0xC1, 0x81, 0x40,
};

static const uint8_t crc_lo[] = {
    0x00, 0xC0, 0xC1, 0x01, 0xC3, 0x03, 0x02, 0xC2, 0xC6, 0x06, 0x07, 0xC7, 0x05, 0xC5, 0xC4, 0x04, 0xCC, 0x0C, 0x0D, 0xCD, 0x0F, 0xCF, 0xCE, 0x0E, 0x0A, 0xCA, 0xCB, 0x0B, 0xC9,
    0x09, 0x08, 0xC8, 0xD8, 0x18, 0x19, 0xD9, 0x1B, 0xDB, 0xDA, 0x1A, 0x1E, 0xDE, 0xDF, 0x1F, 0xDD, 0x1D, 0x1C, 0xDC, 0x14, 0xD4, 0xD5, 0x15, 0xD7, 0x17, 0x16, 0xD6, 0xD2, 0x12,
    0x13, 0xD3, 0x11, 0xD1, 0xD0, 0x10, 0xF0, 0x30, 0x31, 0xF1, 0x33, 0xF3, 0xF2, 0x32, 0x36, 0xF6, 0xF7, 0x37, 0xF5, 0x35, 0x34, 0xF4, 0x3C, 0xFC, 0xFD, 0x3D, 0xFF, 0x3F, 0x3E,
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    0x4E, 0x8E, 0x8F, 0x4F, 0x8D, 0x4D, 0x4C, 0x8C, 0x44, 0x84, 0x85, 0x45, 0x87, 0x47, 0x46, 0x86, 0x82, 0x42, 0x43, 0x83, 0x41, 0x81, 0x80, 0x40,
};

uint16_t compute_crc(uint8_t* buf, uint16_t len)
{
    uint16_t hi = 0xFF;
    uint16_t lo = 0xFF;
    uint16_t i = 0;

    while (len--) {
        i = lo ^ *(buf++);
        lo = (uint16_t)(hi ^ crc_hi[i]);
        hi = crc_lo[i];
    }
    return (lo << 8 | hi);
}

static void serial_modbus_task_func(void* param)
{
    uint8_t buf[BUF_SIZE];
    uart_event_t event;

    while (true) {
        if (xQueueReceive(uart_queue, (void*)&event, portMAX_DELAY)) {
            switch (event.type) {
            case UART_DATA:
                if (event.timeout_flag) {
                    uint16_t len = uart_read_bytes(port, buf, event.size, portMAX_DELAY);

                    ESP_LOG_LEVEL(LOG_LVL_DATA, TAG, "Received buffer length %d", event.size);
                    ESP_LOG_BUFFER_HEX_LEVEL(TAG, buf, event.size, LOG_LVL_DATA);

                    len -= 2;
                    if (len > 2) {
                        if (compute_crc(buf, len) == MODBUS_READ_UINT16(buf, len)) {
                            len = modbus_request_exec(buf, len);
                            if (len > 0) {
                                MODBUS_WRITE_UINT16(buf, len, compute_crc(buf, len));
                                len += 2;

                                ESP_LOG_LEVEL(LOG_LVL_DATA, TAG, "Write buffer length %d", len);
                                ESP_LOG_BUFFER_HEX_LEVEL(TAG, buf, len, LOG_LVL_DATA);

                                uart_write_bytes(port, buf, len);
                            }
                        } else {
                            ESP_LOGW(TAG, "Invalid packet CRC");
                        }
                    } else {
                        ESP_LOGW(TAG, "Invalid packet data length");
                    }
                }
                break;
            case UART_FIFO_OVF:
                xQueueReset(uart_queue);
                break;
            case UART_BUFFER_FULL:
                xQueueReset(uart_queue);
                uart_flush_input(port);
                break;
            default:
                break;
            }
        }
    }
}

void serial_modbus_start(uart_port_t uart_num, uint32_t baud_rate, uart_word_length_t data_bits, uart_stop_bits_t stop_bit, uart_parity_t parity, bool rs485)
{
    ESP_LOGI(TAG, "Starting on uart %d", uart_num);

    uart_config_t uart_config = {
        .baud_rate = baud_rate,
        .data_bits = data_bits,
        .parity = parity,
        .stop_bits = stop_bit,
        .flow_ctrl = UART_HW_FLOWCTRL_DISABLE,
        .rx_flow_ctrl_thresh = 2,
        .source_clk = UART_SCLK_APB,
    };

    esp_err_t err = uart_param_config(uart_num, &uart_config);
    if (err != ESP_OK) {
        ESP_LOGE(TAG, "uart_param_config() returned 0x%x", err);
        return;
    }

    err = uart_driver_install(uart_num, BUF_SIZE, BUF_SIZE, EVENT_QUEUE_SIZE, &uart_queue, ESP_INTR_FLAG_LOWMED);
    if (err != ESP_OK) {
        ESP_LOGE(TAG, "uart_driver_install() returned 0x%x", err);
        return;
    }
    port = uart_num;

    if (rs485) {
        err = uart_set_mode(uart_num, UART_MODE_RS485_HALF_DUPLEX);
        if (err != ESP_OK) {
            ESP_LOGE(TAG, "uart_set_mode() returned 0x%x", err);
            return;
        }
        err = uart_set_rx_timeout(uart_num, 3);
        if (err != ESP_OK) {
            ESP_LOGE(TAG, "uart_set_rx_timeout() returned 0x%x", err);
            return;
        }
    }

    uart_set_always_rx_timeout(uart_num, true);

    xTaskCreate(serial_modbus_task_func, "serial_modbus_task", 2 * 1024, NULL, 5, &serial_modbus_task);
}

void serial_modbus_stop(void)
{
    ESP_LOGI(TAG, "Stopping");

    if (serial_modbus_task) {
        vTaskDelete(serial_modbus_task);
        serial_modbus_task = NULL;
    }

    if (port != -1) {
        uart_driver_delete(port);
        port = -1;
    }
}